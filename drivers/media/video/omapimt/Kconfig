## drivers/media/video/omapimt/Kconfig
```kconfig
config VIDEO_OMAP_IMT
	tristate "OMAP IVAHD Memory & Trace"
	select OMAP_RPMSG
	default n
	help
	  OMAP side IVAHD tracing and memory allocation
	  
```

## drivers/staging/thermal_framework/sensor/Kconfig
```kconfig
#
# Thermal Temp sensor configuration
#

config OMAP4_DIE_TEMP_SENSOR
	bool "OMAP4460 On-Die temp sensor support"
	depends on THERMAL_FRAMEWORK && OMAP_THERMAL && OMAP_TEMP_SENSOR
	help
	  Enabling this config will give support for the on-die
	  temp sensor for the OMAP4460 platform.

config OMAP443X_DIE_TEMP_SENSOR
	bool "OMAP443X On-Die temp sensor support"
	depends on THERMAL_FRAMEWORK && OMAP_THERMAL && OMAP_TEMP_SENSOR
	help
	  Enabling this config will give support for the on-die
	  temp sensor for the OMAP443x platform.

config OMAP4_PCB_SENSOR
	bool "OMAP PCB temp sensor support"
	depends on THERMAL_FRAMEWORK && OMAP_THERMAL && OMAP_TEMP_SENSOR
	help
	  Enabling this config will give support for the pcb
	  temp sensor for the OMAP platform.

config OMAP4_TMP102_SENSOR
	bool "OMAP TMP102 temp sensor support"
	depends on THERMAL_FRAMEWORK && OMAP_THERMAL && OMAP_TEMP_SENSOR
	help
	  Enabling this config will give support for the tmp102
	  temp sensor for the OMAP platform.
```

## fs/rawfs/Kconfig
```kconfig
config RAWFS_FS
	tristate "Raw file system support"
	depends on BLOCK
	---help---
	  This is a very small file system.
	  
	  If you don't know whether you need it, then you don't need it:
	  answer N.


config RAWFS_FS_DISABLE_WRITEPROT
       bool "Ignore write protection"
	depends on RAWFS_FS
	default n
	help
	  Be careful using this configuration parameter.
	  If you don't know whether you need it answer N.
	
```
